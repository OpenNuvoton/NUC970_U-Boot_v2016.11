## board/nuvoton/n32926/Kconfig
```kconfig
if (TARGET_N32926 || TARGET_N32926_DISP)

config SYS_BOARD
	default "n32926"

config SYS_VENDOR
	default "nuvoton"

config SYS_SOC
	default "n32926"

config SYS_CONFIG_NAME
        default "n32926_soc" if TARGET_N32926
        default "n32926_disp" if TARGET_N32926_DISP

config N32926
	bool
	default y

config N32926_EMAC_NO_MDC
	bool
	default y if TARGET_N32926_DISP

endif
```

## board/nuvoton/n9h30/Kconfig
```kconfig
if (TARGET_N9H30)

config SYS_BOARD
	default "n9h30"

config SYS_VENDOR
	default "nuvoton"

config SYS_SOC
	default "n9h30"

config SYS_CONFIG_NAME
	default "n9h30_evb" if TARGET_N9H30

config N9H30
	bool
	default y

endif
```

## board/nuvoton/nuc970/Kconfig
```kconfig
if (TARGET_NUC970 || TARGET_NUC970_TOMATO || TARGET_NUC970_ETH2UART || TARGET_N9H30_MATTER)

config SYS_BOARD
	default "nuc970"

config SYS_VENDOR
	default "nuvoton"

config SYS_SOC
	default "nuc970"

config SYS_CONFIG_NAME
	default "nuc970_evb" if TARGET_NUC970
	default "nuc970_tomato" if TARGET_NUC970_TOMATO
	default "nuc970_eth2uart" if TARGET_NUC970_ETH2UART
	default "n9h30_matter" if TARGET_N9H30_MATTER

config NUC970
	bool
	default y

config NUC970_HW_CHECKSUM
	bool
	default y if TARGET_NUC970_TOMATO

endif
```

## board/nuvoton/nuc980/Kconfig
```kconfig
if (TARGET_NUC980 || TARGET_NUC980_TOMATO || TARGET_NUC980_ETH2UART || TARGET_NUC980_IOT || TARGET_NUC980_CHILI || TARGET_NUC980_LORAG)

config SYS_BOARD
	default "nuc980"

config SYS_VENDOR
	default "nuvoton"

config SYS_SOC
	default "nuc980"

config SYS_CONFIG_NAME
	default "nuc980_evb" if TARGET_NUC980
	default "nuc980_tomato" if TARGET_NUC980_TOMATO
	default "nuc980_eth2uart" if TARGET_NUC980_ETH2UART
	default "nuc980_iot" if TARGET_NUC980_IOT
	default "nuc980_lorag" if TARGET_NUC980_LORAG
	default "nuc980_chili" if TARGET_NUC980_CHILI
config NUC980
	bool
	default y

config NUC980_HW_CHECKSUM
	bool
	default y if TARGET_NUC980_TOMATO

endif
```

## configs/n32926_disp_defconfig
```kconfig
CONFIG_ARM=y
CONFIG_N32926=y
CONFIG_TARGET_N32926_DISP=y
CONFIG_BOOTDELAY=0
CONFIG_LOCALVERSION="DISP926V1"
CONFIG_CC_OPTIMIZE_FOR_SIZE=y

CONFIG_SYS_HZ=1000
CONFIG_CMD_TIMER=y
CONFIG_CMD_PING=y
CONFIG_CMD_DHCP=y

CONFIG_N32926_CONSOLE=y
CONFIG_HUSH_PARSER=y
CONFIG_NETDEVICES=y

CONFIG_N32926_EMAC_NO_MDC=y
CONFIG_N32926_ETH=y
CONFIG_N32926_PHY_ADDR=1

CONFIG_N32926_GPIO=y
CONFIG_CMD_GPIO=y

CONFIG_N32926_I2C=y
CONFIG_SYS_I2C=y
CONFIG_SYS_I2C_SPEED=50
CONFIG_N32926_I2C_PB=y
CONFIG_N32926_I2C_SPEED=50

CONFIG_N32926_SPI=y
CONFIG_CMD_SPI=y
CONFIG_CMD_SF=y
CONFIG_SPI_FLASH=y
CONFIG_SPI_FLASH_WINBOND=y
CONFIG_SPI_FLASH_GIGADEVICE=y
CONFIG_SPI_FLASH_BAR=y

#CONFIG_N32926_WATCHDOG=y

#CONFIG_RTC_N32926=y

CONFIG_FS_JFFS2=y
```

## configs/n9h30_defconfig
```kconfig
CONFIG_ARM=y
CONFIG_NUC970=y
CONFIG_TARGET_NUC970=y
CONFIG_SYS_NO_FLASH=y
CONFIG_BOOTDELAY=3

CONFIG_SYS_HZ=1000
CONFIG_CMD_TIMER=y
CONFIG_CMD_PING=y
CONFIG_CMD_DHCP=y
CONFIG_CMD_JFFS2=y

CONFIG_SPL=y
CONFIG_NAND_NUC970=y
CONFIG_CMD_NAND=y
CONFIG_CMD_UBI=y

CONFIG_NUC970_CONSOLE=y
CONFIG_HUSH_PARSER=y
CONFIG_NUC970_GPIO=y
CONFIG_LCD=y
CONFIG_NUC970_LCD=y
CONFIG_LCD_FW070TFT=y
CONFIG_SYS_CONSOLE_OVERWRITE_ROUTINE=y
CONFIG_CONSOLE_SCROLL_LINES=1

#CONFIG_NUC970_SPI=y
#CONFIG_NUC970_SPI_Quad=y
#CONFIG_CMD_SPI=y
#CONFIG_CMD_SF=y
#CONFIG_SPI_FLASH=y
#CONFIG_SPI_FLASH_WINBOND=y
#CONFIG_SPI_FLASH_BAR=y

CONFIG_NUC970_WATCHDOG=y

CONFIG_USB=y
CONFIG_USB_EHCI_NUC970=y
CONFIG_CMD_USB=y
CONFIG_CMD_FAT=y
CONFIG_USB_STORAGE=y
CONFIG_USB_EHCI=y
CONFIG_USB_EHCI_HCD=y


# CONFIG_CMD_IMLS is not set
# CONFIG_CMD_FLASH is not set
# CONFIG_CMD_SETEXPR is not set
# CONFIG_DM_SERIAL is not set
```

## configs/nuc970_defconfig
```kconfig
CONFIG_ARM=y
CONFIG_NUC970=y
CONFIG_TARGET_NUC970=y
CONFIG_SYS_NO_FLASH=y
CONFIG_BOOTDELAY=3

CONFIG_SYS_HZ=1000
CONFIG_CMD_TIMER=y
CONFIG_CMD_PING=y
CONFIG_CMD_DHCP=y
CONFIG_CMD_JFFS2=y

CONFIG_SPL=y
CONFIG_NAND_NUC970=y
CONFIG_CMD_NAND=y
CONFIG_CMD_UBI=y

#CONFIG_MMC=y
#CONFIG_GENERIC_MMC=y
#CONFIG_NUC970_MMC=y
#CONFIG_CMD_MMC=y
#CONFIG_NUC970_SD_PORT0=y
#CONFIG_NUC970_EMMC=y

CONFIG_NUC970_CONSOLE=y
CONFIG_HUSH_PARSER=y
CONFIG_NETDEVICES=y
CONFIG_NUC970_EMAC0=y
CONFIG_NUC970_ETH=y
CONFIG_NUC970_PHY_ADDR=1
CONFIG_NUC970_GPIO=y
CONFIG_LCD=y
CONFIG_NUC970_LCD=y
CONFIG_LCD_E50A2V1=y
CONFIG_SYS_CONSOLE_OVERWRITE_ROUTINE=y
CONFIG_CONSOLE_SCROLL_LINES=1

#CONFIG_NUC970_SPI=y
#CONFIG_NUC970_SPI_Quad=y
#CONFIG_CMD_SPI=y
#CONFIG_CMD_SF=y
#CONFIG_SPI_FLASH=y
#CONFIG_SPI_FLASH_WINBOND=y
#CONFIG_SPI_FLASH_BAR=y

CONFIG_NUC970_WATCHDOG=y

CONFIG_USB=y
CONFIG_USB_EHCI_NUC970=y
CONFIG_CMD_USB=y
CONFIG_CMD_FAT=y
CONFIG_USB_STORAGE=y
CONFIG_USB_EHCI=y
CONFIG_USB_EHCI_HCD=y


# CONFIG_CMD_IMLS is not set
# CONFIG_CMD_FLASH is not set
# CONFIG_CMD_SETEXPR is not set
# CONFIG_DM_SERIAL is not set
```

## configs/nuc970_disp976_defconfig
```kconfig
CONFIG_ARM=y
CONFIG_NUC970=y
CONFIG_TARGET_NUC970_DISP976=y
CONFIG_BOOTDELAY=0
CONFIG_NUC970_HW_CHECKSUM=y
CONFIG_LOCALVERSION="DISP976V1"
CONFIG_CC_OPTIMIZE_FOR_SIZE=y

CONFIG_SYS_HZ=1000
CONFIG_CMD_TIMER=y
CONFIG_CMD_PING=y
CONFIG_CMD_DHCP=y

CONFIG_MMC=y
CONFIG_GENERIC_MMC=y
CONFIG_NUC970_MMC=y
CONFIG_NUC970_SD_PORT0=y
#CONFIG_NUC970_EMMC=y

CONFIG_NUC970_CONSOLE=y
CONFIG_HUSH_PARSER=y
CONFIG_NETDEVICES=y

CONFIG_NUC970_EMAC0=y
CONFIG_NUC970_EMAC0_NO_MDC=y
CONFIG_NUC970_ETH=y
CONFIG_NUC970_PHY_ADDR=1

CONFIG_NUC970_GPIO=y
CONFIG_CMD_GPIO=y

CONFIG_NUC970_I2C=y
CONFIG_SYS_I2C=y
CONFIG_SYS_I2C_SPEED=50
CONFIG_ENABLE_NUC970_I2C0=y
CONFIG_NUC970_I2C0_PG=y
CONFIG_NUC970_I2C0_SPEED=50


#CONFIG_LCD=y
#CONFIG_NUC970_LCD=y

CONFIG_NUC970_SPI=y
CONFIG_CMD_SPI=y
CONFIG_CMD_SF=y
CONFIG_SPI_FLASH=y
CONFIG_SPI_FLASH_WINBOND=y
CONFIG_SPI_FLASH_GIGADEVICE=y
CONFIG_SPI_FLASH_BAR=y

CONFIG_NUC970_WATCHDOG=y

CONFIG_RTC_NUC970=y

CONFIG_FS_FAT=y
CONFIG_FS_FAT_MAXCLUSTSIZE=65536
CONFIG_FS_JFFS2=y

# CONFIG_USB_EHCI_NUC970=y
# CONFIG_CMD_IMLS is not set
# CONFIG_CMD_FLASH is not set
# CONFIG_CMD_SETEXPR is not set
# CONFIG_DM_SERIAL is not set
```

## configs/nuc970_disp977v4_defconfig
```kconfig
# Generic CPU settings
CONFIG_ARM=y
CONFIG_NUC970=y
CONFIG_TARGET_NUC970_DISP977V4=y
CONFIG_BOOTDELAY=0
#CONFIG_FIT=y
#CONFIG_FIT_VERBOSE=y
#CONFIG_CMD_BOOTZ=y

# Command-line interface
CONFIG_NUC970_CONSOLE=y
CONFIG_HUSH_PARSER=y
CONFIG_CMDLINE_EDITING=y
CONFIG_AUTO_COMPLETE=y
#CONFIG_CMD_SETEXPR=y
CONFIG_CMD_MEMORY=n
CONFIG_CMD_CRC32=n

# MMC/SD settings
CONFIG_MMC=y
CONFIG_GENERIC_MMC=y
CONFIG_NUC970_MMC=y
CONFIG_NUC970_SD_PORT0=y
CONFIG_CMD_MMC=y

# Networking
CONFIG_NETDEVICES=y
CONFIG_NUC970_EMAC0=y
CONFIG_NUC970_PHY_IP175L_MDC=y
CONFIG_NUC970_ETH=y
CONFIG_NUC970_PHY_ADDR=1
CONFIG_CMD_NET=y
CONFIG_CMD_PING=y
CONFIG_CMD_DHCP=y
CONFIG_NUC970_ETHADDR_FROM_EEPROM=y
CONFIG_NUC970_ETHADDR_EEPROM_I2C_ADDR=50
CONFIG_NUC970_ETHADDR_EEPROM_OFFSET=FA

# GPIO functionality
CONFIG_NUC970_GPIO=y
CONFIG_NUC970_I2C_PG_PU=y
#CONFIG_CMD_GPIO=y

# SPI interface and SPI Flash
CONFIG_NUC970_SPI=y
CONFIG_NUC970_SPI_Normal=y
#CONFIG_CMD_SPI=y
CONFIG_CMD_SF=y
CONFIG_SPI_FLASH=y
CONFIG_SPI_FLASH_BAR=y
CONFIG_SPI_FLASH_ATMEL=y
CONFIG_SPI_FLASH_GIGADEVICE=y
CONFIG_SPI_FLASH_WINBOND=y
CONFIG_SPI_FLASH_SST=y

# I2C interface
CONFIG_SYS_I2C=y
CONFIG_SYS_I2C_SOFT=y
CONFIG_CMD_I2C=y

# Watchdog support
CONFIG_NUC970_WATCHDOG=y
```

## configs/nuc970_eth2uart_defconfig
```kconfig
CONFIG_ARM=y
CONFIG_NUC970=y
CONFIG_TARGET_NUC970_ETH2UART=y
CONFIG_BOOTDELAY=0

CONFIG_MMC=y
CONFIG_GENERIC_MMC=y
CONFIG_NUC970_MMC=y
CONFIG_NUC970_SD_PORT0=y
#CONFIG_NUC970_EMMC=y

CONFIG_NUC970_CONSOLE=y
CONFIG_HUSH_PARSER=y
CONFIG_NETDEVICES=y
CONFIG_NUC970_EMAC0=y
CONFIG_NUC970_ETH=y
CONFIG_NUC970_PHY_ADDR=1
CONFIG_NUC970_GPIO=y
#CONFIG_LCD=y
#CONFIG_NUC970_LCD=y

CONFIG_NUC970_SPI=y
CONFIG_CMD_SPI=y
CONFIG_CMD_SF=y
CONFIG_SPI_FLASH=y
CONFIG_SPI_FLASH_EON=y
CONFIG_SPI_FLASH_BAR=y

CONFIG_NUC970_WATCHDOG=y
CONFIG_USB_EHCI_NUC970=y
# CONFIG_CMD_IMLS is not set
# CONFIG_CMD_FLASH is not set
# CONFIG_CMD_SETEXPR is not set
# CONFIG_DM_SERIAL is not set
```

## configs/nuc970_lan977_defconfig
```kconfig
CONFIG_ARM=y
CONFIG_NUC970=y
CONFIG_TARGET_NUC970_LAN977=y
CONFIG_BOOTDELAY=1

CONFIG_MMC=y
CONFIG_GENERIC_MMC=y
CONFIG_NUC970_MMC=y
CONFIG_NUC970_SD_PORT0=y
CONFIG_CMD_MMC=y

CONFIG_NUC970_CONSOLE=y
CONFIG_HUSH_PARSER=y
CONFIG_CMDLINE_EDITING=y
CONFIG_AUTO_COMPLETE=y
CONFIG_NETDEVICES=y
CONFIG_NUC970_EMAC0=y
CONFIG_NUC970_PHY_KSZ8895_MDC=y
CONFIG_NUC970_ETH=y
CONFIG_NUC970_PHY_ADDR=1
CONFIG_CMD_NET=y
CONFIG_CMD_PING=y
CONFIG_CMD_DHCP=y

CONFIG_NUC970_GPIO=y
CONFIG_CMD_GPIO=y

CONFIG_NUC970_SPI=y
CONFIG_NUC970_SPI_Normal=y
CONFIG_CMD_SPI=y
CONFIG_CMD_SF=y
CONFIG_SPI_FLASH=y

CONFIG_SPI_FLASH_ATMEL=y
CONFIG_SPI_FLASH_GIGADEVICE=y
CONFIG_SPI_FLASH_WINBOND=y
CONFIG_SPI_FLASH_SST=y
CONFIG_SPI_FLASH_BAR=y
CONFIG_NUC970_I2C=y
CONFIG_SYS_I2C=y
CONFIG_SYS_I2C_SPEED=50000
CONFIG_ENABLE_NUC970_I2C0=y
CONFIG_NUC970_I2C0_PG=y
CONFIG_NUC970_I2C0_SPEED=50000
CONFIG_CMD_I2C=y

CONFIG_NUC970_WATCHDOG=y

CONFIG_CMD_SETEXPR=y

# CONFIG_USB_EHCI_NUC970=y
# CONFIG_CMD_IMLS is not set
# CONFIG_CMD_FLASH is not set
# CONFIG_DM_SERIAL is not set
```

## configs/nuc970_min_defconfig
```kconfig
CONFIG_ARM=y
CONFIG_NUC970=y
CONFIG_TARGET_NUC970_MIN=y
CONFIG_BOOTDELAY=0

CONFIG_MMC=y
CONFIG_GENERIC_MMC=y
CONFIG_NUC970_MMC=y
CONFIG_NUC970_SD_PORT0=y
#CONFIG_NUC970_EMMC=y

CONFIG_NUC970_CONSOLE=y
CONFIG_HUSH_PARSER=y
CONFIG_NETDEVICES=y
CONFIG_NUC970_EMAC0=y
CONFIG_NUC970_EMAC0_NO_MDC=y
CONFIG_NUC970_ETH=y
CONFIG_NUC970_PHY_ADDR=1
CONFIG_NUC970_GPIO=y

CONFIG_NUC970_SPI=y
CONFIG_NUC970_SPI_Normal=y
CONFIG_CMD_SPI=y
CONFIG_CMD_SF=y
CONFIG_SPI_FLASH=y
CONFIG_SPI_FLASH_EON=y
CONFIG_SPI_FLASH_ATMEL=y
CONFIG_SPI_FLASH_GIGADEVICE=y
CONFIG_SPI_FLASH_WINBOND=y
CONFIG_SPI_FLASH_BAR=y

CONFIG_NUC970_WATCHDOG=y
```

## configs/nuc980_defconfig
```kconfig
CONFIG_ARM=y
CONFIG_NUC980=y
CONFIG_TARGET_NUC980=y
CONFIG_SYS_NO_FLASH=y
CONFIG_BOOTDELAY=3

CONFIG_SYS_HZ=1000
CONFIG_CMD_TIMER=y
#CONFIG_CMD_PING=y
#CONFIG_CMD_DHCP=y
#CONFIG_CMD_JFFS2=y

CONFIG_SPL=y
CONFIG_NAND_NUC980=y
CONFIG_CMD_NAND=y
#CONFIG_CMD_UBI=y

#CONFIG_MMC=y
#CONFIG_GENERIC_MMC=y
#CONFIG_NUC980_MMC=y
#CONFIG_CMD_MMC=y
#CONFIG_NUC980_SD_PORT0=y
#CONFIG_NUC980_EMMC=y

CONFIG_NUC980_CONSOLE=y
CONFIG_HUSH_PARSER=y
#CONFIG_NETDEVICES=y
#CONFIG_NUC980_EMAC0=y
#CONFIG_NUC980_ETH=y
#CONFIG_NUC980_PHY_ADDR=1
#CONFIG_CMD_NET=y
#CONFIG_CMD_PING=y
CONFIG_NUC980_GPIO=y
CONFIG_SYS_CONSOLE_OVERWRITE_ROUTINE=y
CONFIG_CONSOLE_SCROLL_LINES=1

#CONFIG_NUC980_SPI=y
#CONFIG_USE_NUC980_QSPI0=y
#CONFIG_NUC980_SPI_Quad=y
#CONFIG_CMD_SPI=y
#CONFIG_CMD_SF=y
#CONFIG_SPI_FLASH=y
#CONFIG_SPI_FLASH_WINBOND=y
#CONFIG_SPI_FLASH_BAR=y

#CONFIG_NUC980_WATCHDOG=y

#CONFIG_USB=y
#CONFIG_USB_EHCI_NUC980=y
#CONFIG_CMD_USB=y
#CONFIG_CMD_FAT=y
#CONFIG_USB_STORAGE=y
#CONFIG_USB_EHCI=y
#CONFIG_USB_EHCI_HCD=y


# CONFIG_CMD_IMLS is not set
# CONFIG_CMD_FLASH is not set
# CONFIG_CMD_SETEXPR is not set
# CONFIG_DM_SERIAL is not set
```

## drivers/rtc/Kconfig
```kconfig
#
# RTC drivers configuration
#

menu "Real Time Clock"

config DM_RTC
	bool "Enable Driver Model for RTC drivers"
	depends on DM
	help
	  Enable drver model for real-time-clock drivers. The RTC uclass
	  then provides the rtc_get()/rtc_set() interface, delegating to
	  drivers to perform the actual functions. See rtc.h for a
	  description of the API.

config RTC_NUC970
       select CMD_DATE
       bool "NUC970/N9H30 RTC support"
       depends on NUC970

endmenu
```

## drivers/watchdog/Kconfig
```kconfig
config NUC970_WATCHDOG
	bool "NUC970/N9H30 Watchdog"
	depends on NUC970

config NUC980_WATCHDOG
	bool "NUC980 Watchdog"
	depends on NUC980
```
